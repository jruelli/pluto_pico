## boards/raspberrypi/pluto_pico/board.yml
```yaml
board:
  name: pluto_pico
  vendor: raspberrypi
  socs:
  - name: rp2040
    variants:
    - name: w
```

## west.yml
```yaml
manifest:
  remotes:
    - name: zephyrproject-rtos
      url-base: https://github.com/zephyrproject-rtos

  projects:
    - name: zephyr
      remote: zephyrproject-rtos
      revision: main
      import:
        name-allowlist:
          - cmsis
          - drivers/sensor/vl53l0x
          - hal_rpi_pico
          - hal_st
```
